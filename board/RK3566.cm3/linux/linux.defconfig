## configs/cm3_defconfig
```kconfig
BR2_TARGET_GENERIC_HOSTNAME="cm3"
BR2_TARGET_GENERIC_ISSUE="Welcome to the cm3 board"

# board/compiler target setup
BR2_aarch64=y
BR2_cortex_a55=y
BR2_ARM_FPU_VFPV4=y
BR2_ARM_EABIHF=y

BR2_OPTIMIZE_2=y

# Rock-Chip repos - mostly for sdcard image generation
BR2_PACKAGE_RKBIN=y

# post build sdcard image generaton
BR2_ROOTFS_POST_BUILD_SCRIPT="$(BR2_EXTERNAL)/board/RK3566.cm3/post-build.sh"
BR2_ROOTFS_POST_IMAGE_SCRIPT="$(BR2_EXTERNAL)/board/RK3566.cm3/post-image.sh"
BR2_ROOTFS_POST_SCRIPT_ARGS="RK3566"

# Filesystems
BR2_TARGET_ROOTFS_EXT2=y
BR2_TARGET_ROOTFS_EXT2_4=y
BR2_TARGET_ROOTFS_EXT2_SIZE="250M"
BR2_PACKAGE_HOST_DOSFSTOOLS=y
BR2_PACKAGE_HOST_MTOOLS=y
BR2_PACKAGE_HOST_UBOOT_TOOLS=y
BR2_PACKAGE_HOST_GENIMAGE=y
BR2_PACKAGE_UTIL_LINUX=y
BR2_PACKAGE_UTIL_LINUX_BINARIES=y
BR2_PACKAGE_UTIL_LINUX_MOUNT=y

# u-boot
BR2_TARGET_UBOOT=y
BR2_TARGET_UBOOT_BUILD_SYSTEM_KCONFIG=y
BR2_TARGET_UBOOT_CUSTOM_GIT=y
BR2_TARGET_UBOOT_CUSTOM_REPO_URL="https://gitlab.com/pgwipeout/u-boot-quartz64.git"
BR2_TARGET_UBOOT_CUSTOM_REPO_VERSION="b7071ce4ece1e83d94638b2b1403b7370086e094"

BR2_TARGET_UBOOT_USE_CUSTOM_CONFIG=y
BR2_TARGET_UBOOT_CUSTOM_CONFIG_FILE="$(BR2_EXTERNAL)/board/RK3566.cm3/uboot/uboot.defconfig"
BR2_TARGET_UBOOT_NEEDS_PYLIBFDT=y
BR2_TARGET_UBOOT_NEEDS_PYELFTOOLS=y
BR2_TARGET_UBOOT_CUSTOM_MAKEOPTS="BL31=${BINARIES_DIR}/rkbin/bin/rk35/rk3568_bl31_v1.24.elf"
BR2_TARGET_UBOOT_CUSTOM_DTS_PATH="$(BR2_EXTERNAL)/board/RK3566.cm3/uboot/rk3566-quartz64-a_spa.dts $(BR2_EXTERNAL)/board/RK3566.cm3/uboot/rk3566-quartz64-a_spa-u-boot.dtsi"
BR2_TARGET_UBOOT_SPL=y
BR2_TARGET_UBOOT_FORMAT_CUSTOM=y
BR2_TARGET_UBOOT_FORMAT_CUSTOM_NAME="u-boot-rockchip.bin"
BR2_TARGET_UBOOT_NEEDS_DTC=y
BR2_PACKAGE_HOST_DTC=y

BR2_PACKAGE_HOST_UBOOT_TOOLS=y
BR2_PACKAGE_HOST_UBOOT_TOOLS_ENVIMAGE=y
BR2_PACKAGE_HOST_UBOOT_TOOLS_ENVIMAGE_SOURCE="${BR2_EXTERNAL}/board/RK3566.cm3/uboot/boot.env"
BR2_PACKAGE_HOST_UBOOT_TOOLS_ENVIMAGE_SIZE="131072"

# linux
BR2_LINUX_KERNEL=y
BR2_LINUX_KERNEL_CUSTOM_VERSION=y
BR2_LINUX_KERNEL_CUSTOM_VERSION_VALUE="6.1"
BR2_LINUX_KERNEL_USE_CUSTOM_CONFIG=y
BR2_LINUX_KERNEL_CUSTOM_CONFIG_FILE="$(BR2_EXTERNAL)/board/RK3566.cm3/linux/linux.defconfig"
BR2_LINUX_KERNEL_INTREE_DTS_NAME="rockchip/rk3566-soquartz-cm4"
BR2_LINUX_KERNEL_CUSTOM_DTS_PATH="$(BR2_EXTERNAL)/board/RK3566.cm3/linux/rk3566-radxa-cm3-spa.dts"
BR2_LINUX_KERNEL_IMAGE=y
BR2_LINUX_KERNEL_IMAGEGZ=y
BR2_LINUX_KERNEL_PATCH=""
BR2_LINUX_KERNEL_CUSTOM_LOGO_PATH=""
BR2_LINUX_KERNEL_DTS_SUPPORT=y
BR2_LINUX_KERNEL_DTB_OVERLAY_SUPPORT=y

# configure the place to source patches, the busybox frament, overlays
BR2_GLOBAL_PATCH_DIR="$(BR2_EXTERNAL)/patches.cm3"
BR2_PACKAGE_BUSYBOX_CONFIG_FRAGMENT_FILES="$(BR2_EXTERNAL)/board/RK3566.cm3/busybox.fragment"
BR2_ROOTFS_OVERLAY="$(BR2_EXTERNAL)/overlays"

# where to store downloads
BR2_DL_DIR="$(BASE_DIR)/../../buildroot.dl"

# external packages
BR2_PACKAGE_NTP=y
BR2_PACKAGE_NTP_NTPDATE=y

BR2_PACKAGE_OPENSSH=y
BR2_PACKAGE_OPENSSH_SERVER=y
BR2_PACKAGE_OPENSSH_CLIENT=y
BR2_SYSTEM_DHCP="eth0"
BR2_PACKAGE_AVAHI=y
BR2_PACKAGE_AVAHI_DAEMON=y

BR2_PACKAGE_HOST_ENVIRONMENT_SETUP=y
```
